## boards/local/minneuro_rhs_devkit/Kconfig
```kconfig
# SPDX-License-Identifier: Apache-2.0

if BOARD_MINNEURO_RHS_DEVKIT_NRF54L15_CPUAPP_NS

DT_NRF_MPC := $(dt_nodelabel_path,nrf_mpc)

config NRF_TRUSTZONE_FLASH_REGION_SIZE
	hex
	default $(dt_node_int_prop_hex,$(DT_NRF_MPC),override-granularity)
	help
	  TrustZone flash region size derived from the nRF MPC node.

config NRF_TRUSTZONE_RAM_REGION_SIZE
	hex
	default $(dt_node_int_prop_hex,$(DT_NRF_MPC),override-granularity)
	help
	  TrustZone RAM region size derived from the nRF MPC node.

endif
```

## boards/local/minneuro_rhs_devkit/Kconfig.defconfig
```kconfig
# SPDX-License-Identifier: Apache-2.0

DT_CHOSEN_Z_CODE_PARTITION := zephyr,code-partition

if BOARD_MINNEURO_RHS_DEVKIT_NRF54L15_CPUAPP_NS

config HAS_BT_CTLR
	default BT

config FLASH_LOAD_OFFSET
	default $(dt_chosen_reg_addr_hex,$(DT_CHOSEN_Z_CODE_PARTITION))

config FLASH_LOAD_SIZE
	default $(dt_chosen_reg_size_hex,$(DT_CHOSEN_Z_CODE_PARTITION))

config BUILD_WITH_TFM
	default y

endif
```

## boards/local/minneuro_rhs_devkit/Kconfig.minneuro_rhs_devkit
```kconfig
# SPDX-License-Identifier: Apache-2.0

config BOARD_MINNEURO_RHS_DEVKIT
	bool

config BOARD_MINNEURO_RHS_DEVKIT_NRF54L15_CPUAPP_NS
	bool
	select BOARD_MINNEURO_RHS_DEVKIT
	select SOC_NRF54L15_CPUAPP
```

## boards/local/minneuro_rhs_devkit/board.yml
```yaml
board:
  name: minneuro_rhs_devkit
  full_name: MinNeuro RHS DevKit
  vendor: local
  socs:
    - name: nrf54l15
      variants:
        - name: ns
          cpucluster: cpuapp
runners:
  run_once:
    '--recover':
      - runners:
          - nrfjprog
          - nrfutil
        run: first
        groups:
          - boards:
              - minneuro_rhs_devkit/nrf54l15/cpuapp/ns
    '--erase':
      - runners:
          - nrfjprog
          - jlink
          - nrfutil
        run: first
        groups:
          - boards:
              - minneuro_rhs_devkit/nrf54l15/cpuapp/ns
    '--reset':
      - runners:
          - nrfjprog
          - jlink
          - nrfutil
        run: last
        groups:
          - boards:
              - minneuro_rhs_devkit/nrf54l15/cpuapp/ns
```

## boards/local/minneuro_rhs_devkit/minneuro_rhs_devkit_nrf54l15_cpuapp_ns_defconfig
```kconfig
# SPDX-License-Identifier: Apache-2.0

CONFIG_ARM_MPU=y
CONFIG_HW_STACK_PROTECTION=y
CONFIG_NULL_POINTER_EXCEPTION_DETECTION_NONE=y
CONFIG_ARM_TRUSTZONE_M=y
CONFIG_TRUSTED_EXECUTION_NONSECURE=y

CONFIG_CACHE_MANAGEMENT=n
CONFIG_EXTERNAL_CACHE=n

CONFIG_CONSOLE=n
CONFIG_UART_CONSOLE=n
CONFIG_SERIAL=n
CONFIG_GPIO=y

CONFIG_NRF_GRTC_START_SYSCOUNTER=y

CONFIG_TFM_BL2=n
CONFIG_TFM_LOG_LEVEL_SILENCE=n
CONFIG_NRF_SKIP_CLOCK_CONFIG=y
```
